## meta-drpai/conf/layer.conf
```bitbake
# We have a conf and classes directory, add to BBPATH
BBPATH .= ":${LAYERDIR}"

# We have recipes-* directories, add to BBFILES
BBFILES += "${LAYERDIR}/recipes-*/*/*.bb \
	${LAYERDIR}/recipes-*/*/*.bbappend"

BBFILE_COLLECTIONS += "drpai"
BBFILE_PATTERN_drpai = "^${LAYERDIR}/"
BBFILE_PRIORITY_drpai = "6"
LAYERSERIES_COMPAT_drpai = "rocko"
```

## meta-isp/conf/layer.conf
```bitbake
# We have a conf and classes directory, add to BBPATH
BBPATH .= ":${LAYERDIR}"

# We have recipes-* directories, add to BBFILES
BBFILES += "${LAYERDIR}/recipes-*/*/*.bb \
	${LAYERDIR}/recipes-*/*/*.bbappend"

BBFILE_COLLECTIONS += "meta-isp"
BBFILE_PATTERN_meta-isp = "^${LAYERDIR}/"
BBFILE_PRIORITY_meta-isp = "7"

PREFERRED_VERSION_libmetal="2018.10%"
PREFERRED_VERSION_open-amp="2018.10%"
```
